## conf/layer.conf
```bitbake
# We have a conf and classes directory, add to BBPATH
BBPATH .= ":${LAYERDIR}"

# We have recipes-* directories, add to BBFILES
BBFILES += "${LAYERDIR}/recipes-*/*/*.bb \
            ${LAYERDIR}/recipes-*/*/*.bbappend"

BBFILE_COLLECTIONS += "meta-ptest-example"
BBFILE_PATTERN_meta-ptest-example = "^${LAYERDIR}/"
BBFILE_PRIORITY_meta-ptest-example = "6"

LAYERDEPENDS_meta-ptest-example = "core"
LAYERSERIES_COMPAT_meta-ptest-example = "dunfell"
```
